## config/west.yml
```yaml
manifest:
  remotes:
    - name: zmkfirmware
      url-base: https://github.com/zmkfirmware
    - name: urob
      url-base: https://github.com/urob
    - name: gpeye                         
      url-base: https://github.com/GPeye
#    - name: padrecc
#      url-base: https://github.com/Padrecc
  projects:
    - name: zmk
      remote: urob
      revision: main
      import: app/west.yml
    - name: hammerbeam-slideshow          
      remote: gpeye                       
      revision: main
#     - name: hammerbeam-slideshow          
#      remote: padrecc                       
#      revision: main                          
  self:
    path: config
```
